## sdkconfig.defaults
```kconfig
# Rust often needs a bit of an extra main task stack size compared to C (the default is 3K)
CONFIG_ESP_MAIN_TASK_STACK_SIZE=15000

# Use this to set FreeRTOS kernel tick frequency to 1000 Hz (100 Hz by default).
# This allows to use 1 ms granularity for thread sleeps (10 ms by default).
CONFIG_FREERTOS_HZ=1000

CONFIG_BT_ENABLED=y
CONFIG_BT_BLUEDROID_ENABLED=y
CONFIG_BT_CLASSIC_ENABLED=n
CONFIG_BTDM_CTRL_MODE_BLE_ONLY=y
CONFIG_BTDM_CTRL_MODE_BR_EDR_ONLY=n
CONFIG_BTDM_CTRL_MODE_BTDM=y
CONFIG_BT_BLE_42_FEATURES_SUPPORTED=y
CONFIG_BT_BLE_50_FEATURES_SUPPORTED=n
CONFIG_BT_BTC_TASK_STACK_SIZE=15000
CONFIG_BT_BLE_DYNAMIC_ENV_MEMORY=y

# For coexist, pin BT to core 1, wifi stay on core 0
CONFIG_BTDM_CTRL_PINNED_TO_CORE=1
CONFIG_BT_BLUEDROID_PINNED_TO_CORE=1

CONFIG_IDF_TARGET="esp32s3"
CONFIG_ESP_DEFAULT_CPU_FREQ_MHZ_240=y
CONFIG_ESPTOOLPY_FLASHMODE_QIO=y
CONFIG_ESPTOOLPY_FLASHFREQ_80M=y
CONFIG_ESPTOOLPY_FLASHSIZE_16MB=y
CONFIG_SPIRAM=y
CONFIG_SPIRAM_MODE_OCT=y
CONFIG_IDF_EXPERIMENTAL_FEATURES=y
CONFIG_SPIRAM_SPEED_80M=y
CONFIG_SPIRAM_FETCH_INSTRUCTIONS=y
CONFIG_SPIRAM_RODATA=y
CONFIG_ESP32S3_DATA_CACHE_LINE_64B=y
CONFIG_ESP32S3_DATA_CACHE_LINE_SIZE=64

#CONFIG_ESP_CONSOLE_USB_SERIAL_JTAG=n

# Enable Bluetooth Bluedroid debug logs
#CONFIG_LOG_DEFAULT_LEVEL_DEBUG=y
#CONFIG_LOG_MAXIMUM_LEVEL_DEBUG=y
#CONFIG_BT_DEBUG_LOG_LEVEL_DEBUG=y
#CONFIG_BT_BLUEDROID_DEBUG=y
#CONFIG_BT_BLUEDROID_DEBUG_LEVEL=4  # Corresponds to ESP_LOG_DEBUG
#CONFIG_BT_LOG_BTC_TRACE_LEVEL_DEBUG=y
#CONFIG_BT_LOG_HCI_TRACE_LEVEL_DEBUG=y
#CONFIG_BT_LOG_BTM_TRACE_LEVEL_DEBUG=y
#CONFIG_BT_LOG_L2CAP_TRACE_LEVEL_DEBUG=y
#CONFIG_BT_BTC_TASK_STACK_SIZE=10000
#CONFIG_BT_LOG_GAP_TRACE_LEVEL_DEBUG=y
#CONFIG_BT_LOG_APPL_TRACE_LEVEL_DEBUG=y
#CONFIG_BT_LOG_GATT_TRACE_LEVEL_DEBUG=y
#CONFIG_BT_LOG_SMP_TRACE_LEVEL_DEBUG=y

####
# KConfig
####
CONFIG_EXAMPLE_LCD_RGB_BOUNCE_BUFFER_HEIGHT=10
CONFIG_EXAMPLE_LVGL_PORT_TASK_MAX_DELAY_MS=500
CONFIG_EXAMPLE_LVGL_PORT_TASK_MIN_DELAY_MS=10
CONFIG_EXAMPLE_LVGL_PORT_TASK_PRIORITY=2
CONFIG_EXAMPLE_LVGL_PORT_TASK_STACK_SIZE_KB=6
# Do not compete with BT
CONFIG_EXAMPLE_LVGL_PORT_TASK_CORE=0
CONFIG_EXAMPLE_LVGL_PORT_TICK=2

CONFIG_EXAMPLE_LVGL_PORT_AVOID_TEAR_ENABLE=y
CONFIG_EXAMPLE_LVGL_PORT_AVOID_TEAR_MODE_3=y
CONFIG_EXAMPLE_LVGL_PORT_ROTATION_180=y

##Not tear ->
#CONFIG_EXAMPLE_LVGL_PORT_BUF_PSRAM=y
##CONFIG_EXAMPLE_LVGL_PORT_BUF_INTERNAL=n
##Not tear ->
#CONFIG_EXAMPLE_LVGL_PORT_BUF_HEIGHT=100
#
# End KConfig


# - defined in lvgl_port.h CONFIG_EXAMPLE_LCD_TOUCH_CONTROLLER_GT911=y
#LV_IMG_CACHE_DEF_SIZE

CONFIG_LV_COLOR_SCREEN_TRANSP=y
CONFIG_LV_MEM_CUSTOM=y
CONFIG_LV_MEMCPY_MEMSET_STD=y
CONFIG_LV_USE_LOG=y
CONFIG_LV_LOG_PRINTF=y
CONFIG_LV_USE_PERF_MONITOR=n
CONFIG_LV_ATTRIBUTE_FAST_MEM_USE_IRAM=y
CONFIG_LV_USE_FONT_COMPRESSED=y
CONFIG_LV_USE_IMGFONT=y
```
